## main/Kconfig
```kconfig
menu "Robot configuration"

    config MINDBRIDGE_MOTOR_LEFT
        int "Mindstorms NXT left motor port"
        default 1
        help
            Specify the port the left motor is connected to.

    config MINDBRIDGE_MOTOR_RIGHT
        int "Mindstorms NXT right motor port"
        default 2
        help
            Specify the port the right motor is connected to.

endmenu

menu "Control Bridge Configuration"

    config MINDBRIDGE_MDNS_HOSTNAME
        string "mDNS Host Name"
        default "mindbridge"
        help
            Specify the mDNS name of the bridge.

    config MINDBRIDGE_ROBOT_SPP_NAME
        string "Mindstorms NXT Bluetooth SPP Name"
        default "Chad"
        help
            Specify the Bluetooth name of the Mindstorms NXT robot.

    config MINDBRIDGE_ACTIVITY_LED
        int "Mindbridge activity LED"
        default 33
        help
            Specify the GPIO line for an activity LED. 2=blue, 33=red, 4=white.

    config MINDBRIDGE_HEADLIGHT_LED
        int "Mindbridge headlight LED"
        default 4
        help
            Specify the GPIO line for an activity LED. 2=blue, 33=red, 4=white.

    config ESP_WIFI_SSID
        string "WiFi SSID"
        default "mcolash"
        help
            SSID (network name) for the device to connect to.

    config ESP_WIFI_PASSWORD
        string "WiFi Password"
        default "candyraisins"
        help
            WiFi password (WPA or WPA2) for the device to use.

    config ESP_MAXIMUM_RETRY
        int "WiFi AP Maximum retry"
        default 5
        help
            Set the Maximum retry to avoid station reconnecting to the AP unlimited when the AP is really inexistent.
endmenu
```

## sdkconfig.defaults
```kconfig
#
# Partition Table
#
CONFIG_PARTITION_TABLE_CUSTOM=y
CONFIG_PARTITION_TABLE_CUSTOM_FILENAME="partitions.csv"
CONFIG_PARTITION_TABLE_FILENAME="partitions.csv"




#
# Bluetooth Configuration
#
CONFIG_BT_ENABLED=y
CONFIG_BT_CLASSIC_ENABLED=y
CONFIG_BT_SPP_ENABLED=y

#
# Robot Configuration
#
CONFIG_ROBOT_ACTIVITY_LED=33
```
